## web_server/build/Kconfig/Kconfig.modules
```kconfig
menu "cmsis_6 (/home/yangjie/zephyr/external/modules/hal/cmsis_6)"
osource "$(ZEPHYR_CMSIS_6_KCONFIG)"
config ZEPHYR_CMSIS_6_MODULE
	bool
	default y
endmenu
menu "hal_espressif (/home/yangjie/zephyr/external/modules/hal/espressif)"
osource "/home/yangjie/zephyr/external/modules/hal/espressif/zephyr/Kconfig"
config ZEPHYR_HAL_ESPRESSIF_MODULE
	bool
	default y
	select TAINT_BLOBS

config ZEPHYR_HAL_ESPRESSIF_MODULE_BLOBS
	bool
	default y
endmenu
config ZEPHYR_XTENSA_MODULE
	bool
	default y
menu "lvgl (/home/yangjie/zephyr/external/modules/lib/gui/lvgl)"
osource "/home/yangjie/zephyr/external/modules/lib/gui/lvgl/zephyr/Kconfig"
config ZEPHYR_LVGL_MODULE
	bool
	default y
endmenu
menu "mbedtls (/home/yangjie/zephyr/external/modules/crypto/mbedtls)"
osource "$(ZEPHYR_MBEDTLS_KCONFIG)"
config ZEPHYR_MBEDTLS_MODULE
	bool
	default y
endmenu
menu "picolibc (/home/yangjie/zephyr/external/modules/lib/picolibc)"
osource "/home/yangjie/zephyr/external/modules/lib/picolibc/zephyr/Kconfig"
config ZEPHYR_PICOLIBC_MODULE
	bool
	default y
endmenu
menu "segger (/home/yangjie/zephyr/external/modules/debug/segger)"
osource "$(ZEPHYR_SEGGER_KCONFIG)"
config ZEPHYR_SEGGER_MODULE
	bool
	default y
endmenu
```

## web_server/build/Kconfig/boards/Kconfig.defconfig
```kconfig
# Load Zephyr board defconfig descriptions.
osource "/home/yangjie/zephyr/external/zephyr/boards/espressif/esp32s3_devkitm/Kconfig.defconfig"
```

## web_server/build/Kconfig/boards/Kconfig.sysbuild
```kconfig
# Load Sysbuild board Kconfig descriptions.
osource "/home/yangjie/zephyr/external/zephyr/boards/espressif/esp32s3_devkitm/Kconfig.sysbuild"
```

## wifi/build/Kconfig/Kconfig.sysbuild.modules
```kconfig
config ZEPHYR_CMSIS_6_MODULE
   bool
   default y
config ZEPHYR_HAL_ESPRESSIF_MODULE
   bool
   default y
config ZEPHYR_XTENSA_MODULE
   bool
   default y
config ZEPHYR_LVGL_MODULE
   bool
   default y
config ZEPHYR_MBEDTLS_MODULE
   bool
   default y
config ZEPHYR_PICOLIBC_MODULE
   bool
   default y
config ZEPHYR_SEGGER_MODULE
   bool
   default y
```

## wifi/build/Kconfig/arch/Kconfig
```kconfig
# Load Zephyr Arch Kconfig descriptions.
osource "/home/yangjie/zephyr/external/zephyr/arch/rx/Kconfig"
osource "/home/yangjie/zephyr/external/zephyr/arch/x86/Kconfig"
osource "/home/yangjie/zephyr/external/zephyr/arch/xtensa/Kconfig"
osource "/home/yangjie/zephyr/external/zephyr/arch/sparc/Kconfig"
osource "/home/yangjie/zephyr/external/zephyr/arch/riscv/Kconfig"
osource "/home/yangjie/zephyr/external/zephyr/arch/posix/Kconfig"
osource "/home/yangjie/zephyr/external/zephyr/arch/mips/Kconfig"
osource "/home/yangjie/zephyr/external/zephyr/arch/arm64/Kconfig"
osource "/home/yangjie/zephyr/external/zephyr/arch/arm/Kconfig"
osource "/home/yangjie/zephyr/external/zephyr/arch/arc/Kconfig"
```

## wifi/build/Kconfig/boards/Kconfig.esp32s3_devkitm
```kconfig
# Load board Kconfig descriptions.
osource "/home/yangjie/zephyr/external/zephyr/boards/espressif/esp32s3_devkitm/Kconfig.esp32s3_devkitm"
```
